## linux/drivers/input/keyboard/coreriver/Kconfig
```kconfig
#
# Coreriver touchkey configuration
#

config KEYBOARD_CORERIVER_TOUCHKEY
        tristate "Coreriver touchkey support"
        default n
        help
          Say Y here to enable the
          coreriver touchkey.
          To compile this driver as a
          module, choose M here.
```

## linux/drivers/media/radio/bcm4343s/Kconfig
```kconfig
#
#  BCM 4343s V4l2 driver.
#
menu "BCM4343S FM driver (V4L2 based)"
config RADIO_BCM4343S
	tristate "Broadcom BCM4343S FM Radio"
	depends on VIDEO_V4L2

	help
	Choose Y here if you have this FM radio chip.

	In order to control your radio card, you will need to use programs
	that are compatible with the Video For Linux 2 API.  Information on
	this API and pointers to "v4l2" programs may be found at
	<file:Documentation/video4linux/API.html>.

endmenu
```

## linux/drivers/platform/sprd/Kconfig
```kconfig
#
# SPREADTRUM Platform Specific Drivers
#
menu "Spreadtrum Platform Specific Drivers"

menu "Spreadtrum Adie Type"
config ADIE_SC2713
	bool "Spredtrum A-die SC2713 Chip Support"
        default n
	help
	  Say Y here to support for Spreadtrum a-die sc2713 chip.

config ADIE_SC2713S
	bool "Spredtrum A-die SC2713S Chip Support"
        default n
	help
	  Say Y here to support for Spreadtrum a-die sc2713s chip.

config ADIE_SC2711
	bool "Spredtrum A-die SC2711 Chip Support"
        default n
	help
	  Say Y here to support for Spreadtrum a-die sc2711 chip.

config ADIE_SC2723
	bool "Spredtrum A-die SC2723 Chip Support"
        default n
	help
	  Say Y here to support for Spreadtrum a-die sc2723 chip.

config ADIE_SC2723S
	bool "Spredtrum A-die SC2723S Chip Support"
        default n
	help
	  Say Y here to support for Spreadtrum a-die sc2723S chip.
endmenu

config BUS_MONITOR_DEBUG
    bool "Spreadtrum BM Support"
	default y
	help
	  Say Y here to support debug busmonitor

config SC_FPGA
	bool "Spreadtrum FPGA support"
	default n
	help
	  This is used for FPGA verification

config SCX35L64BIT_FPGA
	bool "Spreadtrum FPGA platform"
	depends on ARCH_SCX35L64
	select  SC_FPGA
	default n
	help
	  SCX35L64BIT_FPGA fpga platform

config SC_VIBRATOR
        bool "vibrator for SC serials"
        select ANDROID_TIMED_OUTPUT
        default n

config SPRD_VIBRATOR_2723
        bool "vibrator for sprd_vibrator_2723"
        select ANDROID_TIMED_OUTPUT
        default n

config SC_VIBRATOR_GPIO
        bool "vibrator for SC serials by gpio"
        default n
	depends on SC_VIBRATOR

config SC_VIBRATOR_POWER
        bool "vibrator for SC serials by power"
        default n
	depends on SC_VIBRATOR

config SPRD_ION_MM_SIZE
        int "size for ion"
        range 1 64
        default 1
	depends on ION

config SPRD_ION_OVERLAY_SIZE
        int "size for ion overlay"
        range 1 64
        default 1
	depends on ION

config SPRD_VIBRATOR_2723
        bool "vibrator for sprd_vibrator_2723"
        select ANDROID_TIMED_OUTPUT
        default n

config EIRQ_NUM
        int "number for external irq region desc request"
        range 0 1024
	default 0

config PIN_POWER_DOMAIN_SWITCH
        bool "pin power domain switch for 28nm chip"
		default n

comment "SC8830 ADIE type"

config SC_INTERNAL_ADI
	bool "spreadtrum sc internal adi"
	default y
	depends on ARCH_SCX35

config SC_INTERNAL_ADC
	bool "spreadtrum sc internal adc"
	default y
	depends on ARCH_SCX35

config SC_INTERNAL_WATCHDOG
	bool "spreadtrum sc internal watchdog"
	default y
	depends on ARCH_SCX35

config FIX_V7TAGRAM_BUG
        bool "fix arm-v7 scu tag ram bug"
        default n
	depends on ARCH_SCX35
	depends on SMP

config DDR_VALIDITY_TEST
	bool "test ddr validity before go into ddr"
	default n

config SPRD_CPU_DYNAMIC_HOTPLUG
	bool "cpu dynamic hotplug with DVFS"
	default n
	depends on HOTPLUG_CPU
	depends on ARCH_SCX35

config SPRD_MEM_POOL
	default y
	bool "Using a memory pool to alloc 8k to 64k"
	depends on !COMPACTION
	help
	  This option enables memmory pool for allocating 8k to 64k.

config SPRD_DCDC_DEBUG
	tristate "Enable dcdc debug module"
	default n
	help
	  This option select dcdc debug module.

config SPRD_AVS_DEBUG
	tristate "Enable avs debug module"
	default n
	help
	  This option select avs debug module.

config SPRD_AUX_DEBUG
       tristate "Enable aux debug moduel"
       default n
       help
         This option select aux debug module.

config SPRD_SIMCTRL
	bool "Enable simctrl module"
	default n
	help
	  This option select simctrl module.
config SPRD_MODEM_TD
	bool "SPRD TD modem"
	default n
	help
	  This option select modem type.

config MODEM_W_MEMCUT
	bool "SPRD w modem memory cut"
	default n
	help
	  This option select for w modem memory cut.

config SIPC_TD
	bool "SIPC instance of TD modem"
	select SIPC
	default n

config SIPC_WCDMA
	bool "SIPC instance of WCDMA modem"
	select SIPC
	default n

config SIPC_WCN
	bool "SIPC instance of Wireless Connection"
	select SIPC
	default n

config SIPC_PMIC
	bool "SIPC instance of PMIC arm7 modem"
	select SIPC
	default n


config SIPC_GGE
	bool "SIPC instance of GGE modem"
	select SIPC
	default n

config SIPC_LTE
	bool "SIPC instance of LTE modem"
	select SIPC
	default n

config VOIP_CPT
	bool "VOIP process in modem T,it is processed in modem W by default"
	default n
	depends on SIPC_TD

config VOIP_LTE
	bool "VOIP process in modem LTE,it is processed in modem W by default"
	default n
	depends on SIPC_LTE

config CP_SWITCH
	bool "cp switch"
	default n
	help
	  This option select cp switch

config EAR_LOW_LEVEL_DETECT
        bool "ear detecting trigger is low level"
        default n
config SS_FUNCTION
        bool "only for samsung function"
        default n
config TSP_0_1_A
        bool "For corsica_ve 3131 0.1A board"
        default n

config SPRD_MAILBOX
        bool "Spreadtrum Mailbox IPI Arch"
        default n

config MUIC_CABLE_DETECT
	bool "usb, jig-box and so on cables are detected by external MUIC chip"
	default n
	depends on MFD_SM5504 || MFD_RT8973

config SPRD_SYSDUMP
        bool "Enable SPRD sysdump handler"
        depends on ARM64
        help
          This option enables Spreadtrum sysdump which prepare debug info
	  for u-boot to write into mmc storage after kernel panics.

config SPRD_DEBUG
	bool "Enable SPRD DEBUG"

config SPRD_DEBUG_SCHED_LOG
	bool "SPRD Scheduler Logging Feature"
	depends on SPRD_DEBUG
	default n
	help
	  SPRD Scheduler Logging Feature for Debug use.

config GPS_LSI_S5N6420
bool "LSI_GPS_CHIPSET_HARRIER"
default n

endmenu

comment "Debugging Feature"
menuconfig SEC_DEBUG
	bool "Samsung TN Ramdump Feature"
	default y
	help
	  Samsung TN Ramdump Feature. Use INFORM3 and magic number at 0xc0000000.

if SEC_DEBUG
config SEC_DEBUG_SCHED_LOG
	bool "Samsung Scheduler Logging Feature"
	default n
	help
	  Samsung Scheduler Logging Feature for Debug use.
config SEC_DEBUG_SOFTIRQ_LOG
	bool "Samsung Softirq Logging Feature"
	default n
	depends on SEC_DEBUG_SCHED_LOG
	help
	  Samsung Softirq Logging Feature for Debug use.
	  This option enables us to log softirq enter/exit.
	  It is not only hard-irq which results in scheduler lockup,
	  To be more clear we need to see also softirq logs.

config SEC_DEBUG_SCHED_LOG_NONCACHED
	bool "Samsung Scheduler Logging on noncached buf"
	depends on SEC_DEBUG_SCHED_LOG
	default n
	help
	  This option enables sec_debug_sched_log_noncached support.
	  It can support non-cached sched log in RAM dump and We don't
	  need to concern cache flush status for analyzing sudden
	  lockup issue.

config SEC_DEBUG_TIMER_LOG
	bool "Samsung Timer Logging Feature"
	default n
	help
	  Samsung Timer Logging Feature for Debug use.

config SEC_DEBUG_SEMAPHORE_LOG
	bool "Samsung Semaphore Logging Feature"
	default n
	help
	  Samsung Semaphore Logging Feature for Debug use.

config SEC_DEBUG_USER
	bool "Panic on Userspace fault"
	default y
	help
	  Panic on Userspace fault

config SEC_DEBUG_PM_TEMP
	bool "Temporary Logging for Sleep/Wakeup Issue"
	default n
	help
	  Verbose Log on Sleep/Wakeup.

config SEC_DEBUG_IRQ_EXIT_LOG
	bool "Temporary Logging for IRQ delay"
	default n
	help
	  Verbose Logging for IRQ delay.

config SEC_DEBUG_AUXILIARY_LOG
	bool "Samsung Auxiliary Logging on noncached buf"
	default n
	help
	  This option enables sec_auxiliary_log support.
	  we can log repeated information insuitable for kernel log like DVFS
	  or power domain control information.
	  It can support non-cached auxiliary log in RAM dump and We don't
	  need to concern cache flush status for analyzing sudden
	  system hang issue.

config SEC_DEBUG_FUPLOAD_DUMP_MORE
	bool "Dump more information at forced upload"
	default n
	help
	  More information is printed out when a forced upload happens.
	  It uses customized dump functions instead of panic call.


config SEC_DEBUG_UMP_ALLOC_FAIL
	bool "Show warning message when UMP allcation fails"
	default n
	help
	  When UMP allocation fails there's no way to figure out the reason.
	  For UMP and Mali is supposed to allocate per 1 page,
	  we should take a good look at this failure.
	  This only shows the alloc fail warning.

config SEC_DEBUG_LIST_PANIC
	bool "Panic when list corruption detected"
	default n
	help
	  Panic when list structure corruption detected.
	  Sometimes list corruptions are reported.
	  But it reports only with WARN level.
	  This will immediately stop the system.

config SEC_DEBUG_IOVMM
	bool "panic when iovmm alloc fails"
	default n
	help
	  panic when iovmm allocation fails
	  this will immediately stop the system.

config SEC_FILE_LEAK_DEBUG
	bool "Panic when file leak detected"
	default n
	help
	  Panic when file leak detected.

config SEC_DEBUG_TIMERQUEUE_CORRUPTION
	bool "Panic when timerqueue corruption detected"
	default n
	help
	  Panic when timerqueue corruption detected.

config SEC_DEBUG_ONEKEY
	bool "Check one key for entering forced upload mode in the one key model"
	depends on SEC_DEBUG
	help
	  Samsung Forced Upload Feature for one.

config SEC_WATCHDOG_RESET
	bool "Panic when timerqueue corruption detected"
	default n
	help
	  Use watchdog reset to exit from lockup

if SEC_WATCHDOG_RESET
config SEC_WATCHDOG_PET_TIME
	int "sec watchdog kicking time interval value"
	default 5
endif
endif

config SEC_LOG
	default n
	bool "Enable support for sec_log" if EMBEDDED
	depends on PRINTK
	help
	  This option enables sec_log support. This provides combined
	  log buffer for both bootloader and kernel. It also preserves
	  previous content before reboot.

config SEC_LOG_NONCACHED
	default n
	bool "Enable non cached kernel sec_log support" if EMBEDDED
	depends on SEC_LOG
	help
	  This option enables sec_non_cached_klog support.  It can
	  support non-cached kernel log in RAM dump and We don't need
	  to concern cache flush status for analyzing sudden lockup
	  issue.

config SEC_LOG_LAST_KMSG
	default n
	bool "Enable /proc/last_kmsg support" if EMBEDDED
	depends on SEC_LOG
	help
	  This option enables /proc/last_kmsg support.

config SEC_AVC_LOG
	default n
	bool "Enable avc audit log support" if EMBEDDED
	depends on SEC_DEBUG
	help
	  This option enables additional log buffer for audit log.

config SEC_DEBUG_TSP_LOG
	default n
	bool "Enable tsp log support" if EMBEDDED
	depends on SEC_DEBUG
	help
	  This option enables additional log buffer for tsp log.

config SEC_DEBUG_TIMA_LOG
	default n
	bool "Enable tima log support" if EMBEDDED
	depends on SEC_DEBUG
	help
	  This option enables additional log buffer for tsp log.
```

## linux/drivers/sensors/Kconfig
```kconfig
menu "Sensor support"

config SENSORS
	bool "Support for sensors"
	help
	  Say Y here to add support for accelerometer sensors

if SENSORS

config SENSORS_GP2A002
	tristate "GP2A002 proximity sensor support"
	depends on I2C
	default n
	help
	  If you say yes here you get support for sharp Sensortec's
	  proximity sensors GP2A002.

config SENSORS_GP2A_HAS_REGULATOR
	depends on I2C
	tristate "sensor use connected regulator"
	default n
	help
	  This option enable GP2A002 driver to parse connected regulators.

config SENSORS_LEDA_EN_GPIO
	depends on I2C
	tristate "LEDA_EN controlled by GPIO"
	default n
	help
	  This option enables leda_en controlled by GPIO using optical sensor driver.

config SENSORS_IMS1911
	tristate "IMS1911 proximity sensor support"
	depends on I2C
	default n
	help
	  If you say yes here you get support for sharp Sensortec's
	  proximity sensors SENSORS_IMS1911.

config SENSORS_CM36672P
	tristate "CM36672P proximity sensor support"
	depends on I2C
	default n
	help
	  If you say yes here you get support for
	  proximity sensors SENSORS_CM36672P.

config SENSORS_K2HH
	depends on I2C
	tristate "ST K2HH accelerometer"
	default n
	help
	  This option enables st k2hh accel driver

config SENSORS_K2HH_HAS_REGULATOR
	depends on I2C
	tristate "sensor use connected regulator"
	default n
	help
	  This option enable K2HH driver to parse connected regulators.

endif
endmenu
```
